## components/maix_zm831/Kconfig
```kconfig
config COMPONENT_MAIX_ZM831_ENABLE
    bool "Enable maix_zm831 component"
    default y
    help
        Select this option to enable use maix_zm831 base on opencv4 with lvgl.
```
